## config/west.yml
```yaml
manifest:
  remotes:
    - name: zmkfirmware
      #url-base: https://github.com/zmkfirmware
      url-base: https://github.com/LyleScott
  projects:
    - name: zmk
      remote: zmkfirmware
      revision: kyria_nicenano2_led
      import: app/west.yml
  self:
    path: config
```
